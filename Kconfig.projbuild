## Kconfig.projbuild
```kconfig
comment "Project-specific Kconfig options moved to src/main/Kconfig.projbuild"
source "src/main/Kconfig.projbuild"
```

## sdkconfig.defaults
```kconfig
CONFIG_ESP_TASK_WDT_EN=n
CONFIG_PARTITION_TABLE_CUSTOM=y
CONFIG_PARTITION_TABLE_CUSTOM_FILENAME="partitions.csv"
CONFIG_ESPTOOLPY_FLASHSIZE_8MB=y
CONFIG_BT_ENABLED=y
CONFIG_BT_BLE_ENABLED=y
CONFIG_BT_NIMBLE_ENABLED=y
CONFIG_ESP_COEX_SW_COEXIST_ENABLE=n
CONFIG_ESP_COEX_POWER_MANAGEMENT=n
CONFIG_APP_ENABLE_UART_LINK=y
CONFIG_APP_UART_LINK_UART_PORT=1
CONFIG_APP_UART_LINK_UART_BAUDRATE=115200
CONFIG_APP_UART_LINK_UART_TX_PIN=15
CONFIG_APP_UART_LINK_UART_RX_PIN=23
CONFIG_APP_UART_LINK_USE_HW_FLOWCTRL=n
CONFIG_APP_UART_LINK_UART_RTS_PIN=12
CONFIG_APP_UART_LINK_UART_CTS_PIN=13
CONFIG_ACTIVITY_LED_GPIO=8
```

## src/main/Kconfig.projbuild
```kconfig
menu "Application Configuration"

config APP_ENABLE_ZB_LINK
    bool "Enable UART bridge to Zigbee co-processor"
    default y
    help
        When enabled, the ESP32-C6 brings up UART hardware to exchange
        Zigbee events with the dedicated ESP32-H2 board.

if APP_ENABLE_ZB_LINK

config APP_ZB_LINK_UART_PORT
    int "UART controller"
    range 0 2
    default 1
    help
        Select which UART peripheral is dedicated to the Zigbee link.

config APP_ZB_LINK_UART_BAUDRATE
    int "UART baud rate"
    default 115200
    help
        Baud rate for the inter-controller serial link.

config APP_ZB_LINK_UART_TX_PIN
    int "UART TX GPIO (C6 -> H2)"
    default 15
    help
        GPIO used for UART TX toward the ESP32-H2.

config APP_ZB_LINK_UART_RX_PIN
    int "UART RX GPIO (H2 -> C6)"
    default 23
    help
        GPIO used for UART RX coming from the ESP32-H2.

config APP_ZB_LINK_USE_HW_FLOWCTRL
    bool "Use RTS/CTS flow control"
    default n
    help
        Enable this if RTS/CTS wires are connected between the boards.

config APP_ZB_LINK_UART_RTS_PIN
    int "UART RTS GPIO"
    depends on APP_ZB_LINK_USE_HW_FLOWCTRL
    default 12

config APP_ZB_LINK_UART_CTS_PIN
    int "UART CTS GPIO"
    depends on APP_ZB_LINK_USE_HW_FLOWCTRL
    default 13

config APP_ZB_LINK_DEBUG_LOGS
    bool "Enable verbose UART debug logs"
    default n
    help
        When enabled, every UART frame transmitted/received over the
        Zigbee link is logged with metadata. Useful for bring-up but
        noisy for normal operation.

config APP_ZB_LINK_HANDSHAKE_TIMEOUT_MS
    int "Startup handshake timeout (ms)"
    range 100 10000
    default 3000
    help
        How long the hub should wait for the ESP32-H2 to respond to the
        startup handshake check before timing out.

endif # APP_ENABLE_ZB_LINK

endmenu
```
